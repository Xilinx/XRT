
&amba {
        zyxclmm_drm: zyxclmm_drm@0xA0000000 {
                compatible = "xlnx,zoclsvm";
                status = "okay";
                #stream-id-cells = <1>;
                iommus = <&smmu 0xe80>;
        };
};

&smmu {
    status = "okay";
};

