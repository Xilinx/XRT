## build/versal/project-spec/configs/rootfsconfigs/Kconfig.user
```kconfig
menu "user packages " 
config libvdu-ctrlsw  
	 bool "libvdu-ctrlsw"
	 help
	
config libvdu-omxil  
	 bool "libvdu-omxil"
	 help
	
config gpio-demo  
	 bool "gpio-demo"
	 help
	
config htop  
	 bool "htop"
	 help
	
config iperf3  
	 bool "iperf3"
	 help
	
config kernel-module-vdu  
	 bool "kernel-module-vdu"
	 help
	
config meson  
	 bool "meson"
	 help
	
config packagegroup-petalinux-gstreamer  
	 bool "packagegroup-petalinux-gstreamer"
	 help
	
config peekpoke  
	 bool "peekpoke"
	 help
	
config resize-part  
	 bool "resize-part"
	 help
	
config vdu-firmware  
	 bool "vdu-firmware"
	 help
	
endmenu
```

## src/runtime_src/driver/zynq/kernel2/drm/zoclsvm/Kconfig
```kconfig
config DRM_ZOCLSVM
	tristate "Xilinx Zynq SVM OpenCL"
	depends on DRM && FPGA
	select DRM_KMS_HELPER
	select DRM_KMS_CMA_HELPER
	select DRM_GEM_CMA_HELPER
	select CONFIG_FPGA_MGR_ZYNQMP_FPGA
	help
	  Xilinx Zynq SVM OpenCL Manager
```
